## conf/layer.conf
```bitbake
# We have a conf and classes directory, add to BBPATH
BBPATH .= ":${LAYERDIR}"

# We have recipes-* directories, add to BBFILES
BBFILES += "${LAYERDIR}/recipes-*/*/*.bb \
	${LAYERDIR}/recipes-*/*/*.bbappend"

BBFILE_COLLECTIONS += "ptipp"
BBFILE_PATTERN_ptipp = "^${LAYERDIR}/"
BBFILE_PRIORITY_ptipp = "6"

LAYERSERIES_COMPAT_ptipp = "sumo"
```
